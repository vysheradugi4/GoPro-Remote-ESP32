/*
 * GoPro Remote — ESP32 web server example (ESP-IDF, C++).
 *
 * Responsibilities:
 *   1. Bring up Wi-Fi (a soft-AP by default).
 *   2. Start the HTTP server that serves the embedded web UI.
 *   3. Drive the GoPro over BLE (GP-Control service) via gopro_ble.
 *
 * HTTP endpoints:
 *   GET  /               -> embedded index.html
 *   GET  /api/status     -> JSON snapshot of the camera state
 *   POST /api/connect    -> start scanning/connecting to the camera
 *   POST /api/disconnect -> drop the BLE link
 *   POST /api/shutter    -> start/stop recording (shutter)
 * POST /api/mode -> switch to the next camera preset group (video/photo/timelapse)
 *
 * index.html is embedded into the firmware at build time (see main/CMakeLists.txt).
 */

#include <cstdio>
#include <cstring>

#include "esp_event.h"
#include "esp_http_server.h"
#include "esp_log.h"
#include "esp_mac.h"
#include "esp_netif.h"
#include "esp_wifi.h"
#include "nvs_flash.h"
#include "sdkconfig.h"

#include "gopro_ble.h"

namespace {

constexpr const char *TAG = "gopro_remote";

// Symbols generated by the build from main/www/index.html (EMBED_FILES).
extern const uint8_t index_html_start[] asm("_binary_index_html_start");
extern const uint8_t index_html_end[] asm("_binary_index_html_end");

// Buffer used to render the camera status as JSON before sending it out.
char s_status_json[1024];

// ---------------------------------------------------------------------------
// Small helpers
// ---------------------------------------------------------------------------

// Send a fixed JSON string with the no-store cache policy.
esp_err_t send_json(httpd_req_t *req, const char *json)
{
    httpd_resp_set_type(req, "application/json");
    httpd_resp_set_hdr(req, "Cache-Control", "no-store");
    return httpd_resp_sendstr(req, json);
}

// ---------------------------------------------------------------------------
// HTTP handlers
// ---------------------------------------------------------------------------

esp_err_t index_get_handler(httpd_req_t *req)
{
    const size_t html_len = static_cast<size_t>(index_html_end - index_html_start);

    httpd_resp_set_type(req, "text/html; charset=utf-8");
    httpd_resp_set_hdr(req, "Cache-Control", "no-store");
    return httpd_resp_send(req, reinterpret_cast<const char *>(index_html_start), html_len);
}

// GET /api/status -> full camera state snapshot used by the web UI.
esp_err_t status_get_handler(httpd_req_t *req)
{
    const int written = gopro::status_json(s_status_json, sizeof(s_status_json));
    if (written < 0) {
        return send_json(req, "{\"state\":\"failed\"}");
    }
    return send_json(req, s_status_json);
}

// POST /api/connect -> ask the BLE module to find and connect to the camera.
esp_err_t connect_post_handler(httpd_req_t *req)
{
    const bool queued = gopro::connect();
    return send_json(req, queued ? "{\"status\":\"ok\",\"state\":\"connecting\"}"
                                 : "{\"status\":\"busy\"}");
}

// POST /api/disconnect -> drop the BLE link and go back to idle.
esp_err_t disconnect_post_handler(httpd_req_t *req)
{
    gopro::disconnect();
    return send_json(req, "{\"status\":\"ok\",\"state\":\"idle\"}");
}

// POST /api/shutter -> start or stop recording / capture.
esp_err_t shutter_post_handler(httpd_req_t *req)
{
    gopro::shutter();
    return send_json(req, "{\"status\":\"ok\"}");
}

// POST /api/mode -> cycle the video mode preset (resolution / lens / fps).
esp_err_t mode_post_handler(httpd_req_t *req)
{
    gopro::next_mode();
    return send_json(req, "{\"status\":\"ok\"}");
}

esp_err_t not_found_handler(httpd_req_t *req, httpd_err_code_t /*error*/)
{
    httpd_resp_set_status(req, "404 Not Found");
    httpd_resp_set_type(req, "text/plain; charset=utf-8");
    return httpd_resp_sendstr(req, "404 Not Found");
}

httpd_handle_t start_webserver()
{
    httpd_config_t config = HTTPD_DEFAULT_CONFIG();
    config.server_port = CONFIG_HTTP_PORT;
    config.lru_purge_enable = true;

    httpd_handle_t server = nullptr;
    ESP_ERROR_CHECK(httpd_start(&server, &config));

    httpd_uri_t index_uri = {};
    index_uri.uri = "/";
    index_uri.method = HTTP_GET;
    index_uri.handler = index_get_handler;
    ESP_ERROR_CHECK(httpd_register_uri_handler(server, &index_uri));

    httpd_uri_t status_uri = {};
    status_uri.uri = "/api/status";
    status_uri.method = HTTP_GET;
    status_uri.handler = status_get_handler;
    ESP_ERROR_CHECK(httpd_register_uri_handler(server, &status_uri));

    httpd_uri_t connect_uri = {};
    connect_uri.uri = "/api/connect";
    connect_uri.method = HTTP_POST;
    connect_uri.handler = connect_post_handler;
    ESP_ERROR_CHECK(httpd_register_uri_handler(server, &connect_uri));

    httpd_uri_t disconnect_uri = {};
    disconnect_uri.uri = "/api/disconnect";
    disconnect_uri.method = HTTP_POST;
    disconnect_uri.handler = disconnect_post_handler;
    ESP_ERROR_CHECK(httpd_register_uri_handler(server, &disconnect_uri));

    httpd_uri_t shutter_uri = {};
    shutter_uri.uri = "/api/shutter";
    shutter_uri.method = HTTP_POST;
    shutter_uri.handler = shutter_post_handler;
    ESP_ERROR_CHECK(httpd_register_uri_handler(server, &shutter_uri));

    httpd_uri_t mode_uri = {};
    mode_uri.uri = "/api/mode";
    mode_uri.method = HTTP_POST;
    mode_uri.handler = mode_post_handler;
    ESP_ERROR_CHECK(httpd_register_uri_handler(server, &mode_uri));

    ESP_ERROR_CHECK(httpd_register_err_handler(server, HTTPD_404_NOT_FOUND, not_found_handler));

    ESP_LOGI(TAG, "HTTP server started on port %d", CONFIG_HTTP_PORT);
    return server;
}

// ---------------------------------------------------------------------------
// Wi-Fi
// ---------------------------------------------------------------------------

void wifi_event_handler(void * /*arg*/, esp_event_base_t event_base, int32_t event_id, void *event_data)
{
    if (event_base == WIFI_EVENT) {
#if CONFIG_WIFI_MODE_AP
        if (event_id == WIFI_EVENT_AP_STACONNECTED) {
            auto *event = static_cast<wifi_event_ap_staconnected_t *>(event_data);
            ESP_LOGI(TAG, "Client connected, MAC " MACSTR, MAC2STR(event->mac));
        } else if (event_id == WIFI_EVENT_AP_STADISCONNECTED) {
            auto *event = static_cast<wifi_event_ap_stadisconnected_t *>(event_data);
            ESP_LOGI(TAG, "Client disconnected, MAC " MACSTR, MAC2STR(event->mac));
        }
#else
        if (event_id == WIFI_EVENT_STA_START) {
            ESP_LOGI(TAG, "Connecting to network \"%s\"...", CONFIG_WIFI_STA_SSID);
            esp_wifi_connect();
        } else if (event_id == WIFI_EVENT_STA_DISCONNECTED) {
            ESP_LOGW(TAG, "Connection lost, retrying...");
            esp_wifi_connect();
        }
#endif
    } else if (event_base == IP_EVENT) {
#if !CONFIG_WIFI_MODE_AP
        if (event_id == IP_EVENT_STA_GOT_IP) {
            auto *event = static_cast<ip_event_got_ip_t *>(event_data);
            ESP_LOGI(TAG, "IP obtained: " IPSTR, IP2STR(&event->ip_info.ip));
            ESP_LOGI(TAG, "Open http://" IPSTR, IP2STR(&event->ip_info.ip));
        }
#endif
    }
}

void wifi_init()
{
    ESP_ERROR_CHECK(esp_netif_init());
    ESP_ERROR_CHECK(esp_event_loop_create_default());

    wifi_init_config_t wifi_init_cfg = WIFI_INIT_CONFIG_DEFAULT();
    ESP_ERROR_CHECK(esp_wifi_init(&wifi_init_cfg));

    ESP_ERROR_CHECK(esp_event_handler_register(WIFI_EVENT, ESP_EVENT_ANY_ID, &wifi_event_handler, nullptr));
    ESP_ERROR_CHECK(esp_event_handler_register(IP_EVENT, IP_EVENT_STA_GOT_IP, &wifi_event_handler, nullptr));

#if CONFIG_WIFI_MODE_AP
    esp_netif_create_default_wifi_ap();

    wifi_config_t wifi_config = {};
    std::strncpy(reinterpret_cast<char *>(wifi_config.ap.ssid), CONFIG_WIFI_AP_SSID,
                 sizeof(wifi_config.ap.ssid) - 1);
    wifi_config.ap.ssid_len = std::strlen(CONFIG_WIFI_AP_SSID);
    wifi_config.ap.channel = CONFIG_WIFI_AP_CHANNEL;
    wifi_config.ap.max_connection = 4;
    std::strncpy(reinterpret_cast<char *>(wifi_config.ap.password), CONFIG_WIFI_AP_PASSWORD,
                 sizeof(wifi_config.ap.password) - 1);

    if (std::strlen(CONFIG_WIFI_AP_PASSWORD) == 0) {
        wifi_config.ap.authmode = WIFI_AUTH_OPEN;
    } else {
        wifi_config.ap.authmode = WIFI_AUTH_WPA2_PSK;
    }

    ESP_ERROR_CHECK(esp_wifi_set_mode(WIFI_MODE_AP));
    ESP_ERROR_CHECK(esp_wifi_set_config(WIFI_IF_AP, &wifi_config));
    ESP_ERROR_CHECK(esp_wifi_start());

    ESP_LOGI(TAG, "Access point \"%s\" started", CONFIG_WIFI_AP_SSID);
    ESP_LOGI(TAG, "Connect to it and open http://192.168.4.1");
#else
    esp_netif_create_default_wifi_sta();

    wifi_config_t wifi_config = {};
    std::strncpy(reinterpret_cast<char *>(wifi_config.sta.ssid), CONFIG_WIFI_STA_SSID,
                 sizeof(wifi_config.sta.ssid) - 1);
    std::strncpy(reinterpret_cast<char *>(wifi_config.sta.password), CONFIG_WIFI_STA_PASSWORD,
                 sizeof(wifi_config.sta.password) - 1);
    wifi_config.sta.threshold.authmode = WIFI_AUTH_WPA2_PSK;

    ESP_ERROR_CHECK(esp_wifi_set_mode(WIFI_MODE_STA));
    ESP_ERROR_CHECK(esp_wifi_set_config(WIFI_IF_STA, &wifi_config));
    ESP_ERROR_CHECK(esp_wifi_start());
#endif
}

}  // namespace

extern "C" void app_main(void)
{
    ESP_LOGI(TAG, "Starting GoPro Remote");

    esp_err_t err = nvs_flash_init();
    if (err == ESP_ERR_NVS_NO_FREE_PAGES || err == ESP_ERR_NVS_NEW_VERSION_FOUND) {
        ESP_ERROR_CHECK(nvs_flash_erase());
        err = nvs_flash_init();
    }
    ESP_ERROR_CHECK(err);

    // Wi-Fi first: it creates the default event loop used by the BLE module.
    wifi_init();

    // Initialize BLE and start scanning for a GoPro camera.
    gopro::init();

    start_webserver();
}
